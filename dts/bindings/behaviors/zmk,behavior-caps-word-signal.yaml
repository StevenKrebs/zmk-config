## dts/bindings/behaviors/zmk,behavior-caps-word-signal.yaml
```yaml
description: Caps Word behavior with a logical state-change signal

compatible: "zmk,behavior-caps-word-signal"

include: zero_param.yaml
```

## dts/bindings/behaviors/zmk,behavior-os-mode.yaml
```yaml
description: Toggle the Sharp MIP OS keymap mode

compatible: "zmk,behavior-os-mode"

include: zero_param.yaml
```

## dts/bindings/behaviors/zmk,behavior-screen-keycode.yaml
```yaml
description: Send a screen capture keycode based on the active OS mode

compatible: "zmk,behavior-screen-keycode"

include: zero_param.yaml

properties:
  mac-key:
    type: int
    required: true
  windows-key:
    type: int
    required: true
```

## dts/bindings/behaviors/zmk,behavior-smart-modifier.yaml
```yaml
description: Send a modifier chord based on the active OS mode
compatible: "zmk,behavior-smart-modifier"
include: one_param.yaml

properties:
  mac-key:
    type: int
    required: true
  windows-key:
    type: int
    required: true
```

## dts/bindings/behaviors/zmk,behavior-smart-shift.yaml
```yaml
description: Toggle sentence-aware automatic capitalization
compatible: "zmk,behavior-smart-shift"
include: zero_param.yaml
```
